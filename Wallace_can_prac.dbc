VERSION "HIPBNYYYYYYYYYYYYYYYYYYYYYYYYYYYYYYYYYYYYY/4/%%%/4/'%**4YYY///"

NS_ :

BS_:
BU_: PCM1

BO_ 1911 MotorControllerTx_1: 8 PCM1
 SG_ ReferenceSpeed : 0|16@0+ (0.01,-4.15) [-4.15|4.15] "m/s" Vector__XXX

CM_ BO_ 1911 "Example message";
CM_ BO_ 2147488308 "Example message";
CM_ BO_ 2147484425 "Example message";
